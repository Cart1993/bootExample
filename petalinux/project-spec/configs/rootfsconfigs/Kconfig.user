## petalinux/project-spec/configs/rootfsconfigs/Kconfig.user
```kconfig
menu "user packages " 
config gpio-demo  
	 bool "gpio-demo"
	 help
	
config peekpoke  
	 bool "peekpoke"
	 help
	
config rfclk  
	 bool "rfclk"
	 help
	
config rfdc  
	 bool "rfdc"
	 help
	
config rfdc-read-write  
	 bool "rfdc-read-write"
	 help
	
config rfdc-selftest  
	 bool "rfdc-selftest"
	 help
	
config uart-test  
	 bool "uart-test"
	 help
	
endmenu
```
